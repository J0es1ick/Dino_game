//игра разработаны для ардуино, при использовании экрана 240x320 и двух кнопок. Для взаимодействия с экраном использованы библиотеки adafruit
#include <SPI.h>
#include <Adafruit_GFX.h>
#include <Adafruit_ILI9341.h>

#define TFT_DC 9
#define TFT_CS 10
#define SCREEN_WIDTH 320
#define SCREEN_HEIGHT 240
#define dinoButtonPin 4
#define enemyButtonPin 2

//Дино
//40x40
static const unsigned char PROGMEM dinoRight[] = { 0x0, 0x0, 0x0, 0xff, 0xfc, 0x0, 0x0, 0x0, 0xff, 0xfc, 0x0, 0x0, 0x3,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 0x0, 0x0 };
//40x40
static const unsigned char PROGMEM dinoLeft[] = { 0x0, 0x0, 0x0, 0xff, 0xfc, 0x0, 0x0, 0x0, 0xff, 0xfc, 0x0, 0x0, 0x3,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 0x0, 0x0 };
//40x40
static const unsigned char PROGMEM dinoBruh[] = { 0x0, 0x0, 0x0, 0xff, 0xfc, 0x0, 0x0, 0x0, 0xff, 0xfc, 0x0, 0x0, 0x3,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 0x0, 0x0 };

//Препятствия
//24x32
static const unsigned char PROGMEM oneCactus[] = { 0x0, 0x7e, 0x0, 0x0, 0xff, 0x0, 0x0, 0xff, 0x0, 0x0, 0xff, 0x0, 0x0,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 0xff, 0x0 };
//40x32
static const unsigned char PROGMEM twoCactus[] = { 0x0, 0x7c, 0x0, 0x0, 0x0, 0x0, 0xfe, 0x0, 0x3, 0xe0, 0x0, 0xfe, 0x0,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 0x7, 0xf0 };
//40x32
static const unsigned char PROGMEM threeCactus[] = { 0x1, 0xf8, 0x0, 0x0, 0x0, 0x3, 0xfc, 0x6, 0xf, 0x80, 0x3, 0xfc, 0x7,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 0x1f, 0xc0 };
//16x24
static const unsigned char PROGMEM oneCactusSmall[] = { 0x3, 0xc0, 0x7, 0xe0, 0x7, 0xe0, 0x7, 0xe0, 0x87, 0xe1, 0xc7, 0xe3, 0xe7,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 0x7, 0xe0 };
//24x24
static const unsigned char PROGMEM twoCactusSmall[] = { 0x7, 0x80, 0x0, 0xf, 0xc0, 0x38, 0xf, 0xc0, 0x7c, 0x8f, 0xc0, 0x7c, 0xcf,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 0xc0, 0x7c };
//32x24
static const unsigned char PROGMEM threeCactusSmall[] = { 0x3, 0x80, 0x0, 0x0, 0x7, 0xc6, 0x0, 0x70, 0x7, 0xce, 0x0, 0xf8, 0x7,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 0xe0, 0xf8 };

//Окружение
//72x24
static const unsigned char PROGMEM cloud[] = { 0x0, 0x0, 0x0, 0x0, 0x1f, 0xe0, 0x0, 0x0, 0x0, 0x0, 0x0, 0x0, 0xff,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 0xff, 0x80 };

Adafruit_ILI9341 display = Adafruit_ILI9341(TFT_CS, TFT_DC);

//данные для расчётов динозавра
int dinoX = 20;
int dinoY = SCREEN_HEIGHT - 40;
int dinoWidth = 40;
int dinoHeight = 40;
bool dinoDirection = true;
bool isJumping = false;
int jumpHeight = 0;
int jumpVelocity = 12; 
int prevDinoX = dinoX;
int prevDinoY = dinoY;
int prevJumpHeight = jumpHeight;

//данные для расчётов облака
int cloudX = 240;
int cloudY = SCREEN_HEIGHT - 100;
int cloudWidth = 72;
int cloudHeight = 24;
int prevCloudX = cloudX;

//данные для расчётов земли
const int groundHeight = 2; 

//данные для расчётов препятствий
struct EnemyType {
  const unsigned char PROGMEM *bitmap;
  int width;
  int height;
};

const EnemyType enemyTypes[] = {
  {oneCactus, 24, 32}, 
  {twoCactus, 40, 32},  
  {threeCactus, 40, 32},  
  {oneCactusSmall, 16, 24},
  {twoCactusSmall, 24, 24},
  {threeCactusSmall, 32, 24}
};

const int numEnemyTypes = sizeof(enemyTypes) / sizeof(enemyTypes[0]);
const int maxEnemies = 1; 
const int enemySpawnDistance = 50;
bool enemySpawned = false;

struct Enemy {
  int x;
  int y;
  int width;
  int height;
  int prevX;
  int prevY;
  const EnemyType* type;
};

Enemy enemies[maxEnemies];

//данные для расчёта самой игры
unsigned long startTime;
unsigned long curTime;
int MyScore = 0;
int speed = 15; 
int speedIncreaseThreshold = 500;
const int speedIncreaseIncrement = 2;
int lastScore = -1; 
int16_t x1, y1;
uint16_t w, h;
char scoreBuffer[10]; 
int gameState = 0; 
int numPlayers = 0;

void setup() {
  Serial.begin(9600);
  Serial.println("ILI9341 Test!");
  display.begin();
  pinMode(dinoButtonPin, INPUT_PULLUP);
  pinMode(enemyButtonPin, INPUT_PULLUP);
  startTime = millis();
  display.fillScreen(ILI9341_BLACK);
  enemySpawned = false;
}

void spawnEnemy() {
  if (!enemySpawned) { 
    int randomTypeIndex = random(numEnemyTypes);
    const EnemyType* enemyType = &enemyTypes[randomTypeIndex];
    enemies[0].x = SCREEN_WIDTH; 
    enemies[0].y = SCREEN_HEIGHT - enemyType->height;
    enemies[0].width = enemyType->width;
    enemies[0].height = enemyType->height;
    enemies[0].prevX = enemies[0].x;
    enemies[0].prevY = enemies[0].y;
    enemies[0].type = enemyType;
    enemySpawned = true; 
  }
}

void loop(void) {
  switch (gameState) {
    case 0:
      selectPlayers();
      break;
    case 1:
      gameLoop();
      break;
    case 2:
      gameOver();
      break;
  }
}

void selectPlayers() {
  display.setTextSize(2);
  display.setTextColor(ILI9341_WHITE);
  display.setCursor(SCREEN_HEIGHT / 6, SCREEN_WIDTH / 2 - 40);
  display.println("Push the tempo");

  display.setCursor(SCREEN_WIDTH / 5, SCREEN_HEIGHT / 2 + 40);
  display.println("1 Player");

  display.setCursor(SCREEN_WIDTH / 5, SCREEN_HEIGHT / 2 + 80);
  display.println("2 Players");

  if (digitalRead(dinoButtonPin) == LOW) {
    numPlayers = 1;
    gameState = 1;
    startTime = millis();
    display.fillScreen(ILI9341_BLACK);
    display.drawLine(0, SCREEN_HEIGHT + groundHeight, SCREEN_WIDTH, SCREEN_HEIGHT + groundHeight, ILI9341_WHITE);
    display.drawLine(0, SCREEN_HEIGHT - 110, SCREEN_WIDTH, SCREEN_HEIGHT - 110, ILI9341_WHITE);
  } else if (digitalRead(enemyButtonPin) == LOW) {
    numPlayers = 2;
    gameState = 1;
    startTime = millis();
    display.fillScreen(ILI9341_BLACK);
    display.drawLine(0, SCREEN_HEIGHT + groundHeight, SCREEN_WIDTH, SCREEN_HEIGHT + groundHeight, ILI9341_WHITE);
    display.drawLine(0, SCREEN_HEIGHT - 110, SCREEN_WIDTH, SCREEN_HEIGHT - 110, ILI9341_WHITE);
  }
}

void gameLoop() {
  showScore();
  updateGameElements();
  drawGameElements();
  checkCollision();
  moveCloud();
  handleJump();

  if (numPlayers == 1) {
    if (!enemySpawned && random(100) < 10) { 
      spawnEnemy();
    }
  } else if (numPlayers == 2) {
    if (digitalRead(enemyButtonPin) == LOW) {
      spawnEnemy();
    }
  }
  delay(20);
}

void handleJump() {
  if (digitalRead(dinoButtonPin) == LOW && !isJumping) {
    isJumping = true;
  }
  if (isJumping) {
    jumpHeight += jumpVelocity;
    jumpVelocity -= 2; 
    if (jumpHeight <= 0) {
      isJumping = false;
      jumpHeight = 0;
      jumpVelocity = 12; 
    }
  }
}

void moveCloud () {
  cloudX --;
  if (cloudX < -cloudWidth) {
    cloudX = SCREEN_WIDTH;
  }
}

void updateGameElements() {
  if (enemySpawned) {
    enemies[0].x -= speed + 3;
    if (enemies[0].x < -enemySpawnDistance) {
      enemySpawned = false; 
    }
  }
}

void resetGame() {
  display.fillScreen(ILI9341_BLACK);
  gameState = 0;
  numPlayers = 0;
  MyScore = 0;
  isJumping = false;
  jumpHeight = 0;
  jumpVelocity = 12;
  speed = 15;

  enemies[0].x = -40;
}

void showScore() {
  curTime = millis();
  MyScore = (curTime - startTime) * speed / 1000;

  if (MyScore != lastScore) {
    sprintf(scoreBuffer, "%d", lastScore);
    display.getTextBounds(scoreBuffer, 0, 0, &x1, &y1, &w, &h);
    display.fillRect(0, 0, w, h, ILI9341_BLACK); 

    display.setTextSize(2);
    display.setTextColor(ILI9341_WHITE);
    display.setCursor(0, 0);
    sprintf(scoreBuffer, "%d", MyScore); 
    display.print(scoreBuffer); 

    lastScore = MyScore;
  }

  if (MyScore >= speedIncreaseThreshold) {
    speedIncreaseThreshold += 500; 
    speed += speedIncreaseIncrement; 
  }
}

void drawGameElements() {
  display.fillRect(prevDinoX, prevDinoY - prevJumpHeight, dinoWidth, dinoHeight, ILI9341_BLACK);
  display.fillRect(prevCloudX, cloudY, cloudWidth, cloudHeight, ILI9341_BLACK);

  display.drawBitmap(cloudX, cloudY, cloud, cloudWidth, cloudHeight, ILI9341_WHITE);

  if (dinoDirection) {
    display.drawBitmap(dinoX, dinoY - jumpHeight, dinoRight, dinoWidth, dinoHeight, ILI9341_WHITE);
  } else {
    display.drawBitmap(dinoX, dinoY - jumpHeight, dinoLeft, dinoWidth, dinoHeight, ILI9341_WHITE);
  }

  for (int i = 0; i < maxEnemies; i++) {
    display.fillRect(enemies[i].prevX, enemies[i].prevY, enemies[i].width, enemies[i].height, ILI9341_BLACK);
    display.drawBitmap(enemies[i].x, enemies[i].y, enemies[i].type->bitmap, enemies[i].width, enemies[i].height, ILI9341_WHITE);
    enemies[i].prevX = enemies[i].x;
    enemies[i].prevY = enemies[i].y;
  }

  prevDinoX = dinoX;
  prevDinoY = dinoY;
  prevCloudX = cloudX;
  prevJumpHeight = jumpHeight;
  dinoDirection = !dinoDirection;
}

void checkCollision() {
  for (int i = 0; i < maxEnemies; i++) {
    if (rectIntersect(dinoX, dinoY - jumpHeight, dinoWidth, dinoHeight, enemies[i].x, enemies[i].y, enemies[i].width, enemies[i].height)) {
      display.fillRect(0, 0, SCREEN_WIDTH, SCREEN_HEIGHT / 6, ILI9341_BLACK);
      display.drawBitmap(dinoX, dinoY - jumpHeight, dinoBruh, dinoWidth, dinoHeight, ILI9341_WHITE);
      gameState = 2;
      break; 
    }
  }
}

bool rectIntersect(int x1, int y1, int w1, int h1, int x2, int y2, int w2, int h2) {
  return (x1 < x2 + w2 && x1 + w1 > x2 && y1 < y2 + h2 && y1 + h1 > y2);
}

void gameOver() {
  display.setTextSize(2);
  display.setTextColor(ILI9341_WHITE);
  display.setCursor(0, 0);
  display.print("Game Over!");

  display.setCursor(0, 40);
  sprintf(scoreBuffer, "Score: %d", MyScore);
  display.print(scoreBuffer);

  display.setCursor(0, 80);
  display.print("Press 1-st button");

  display.setCursor(0, 100);
  display.print("to Restart");

  if (digitalRead(dinoButtonPin) == LOW) {
    resetGame();
  }
}
